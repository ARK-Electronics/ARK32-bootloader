# MCXA133 register map
Vendor: nxp.com; File version: 1.0
CPU: CM33 r2p0, little endian, no MPU, no FPU, VTOR, 3 interrupt priority bits
Registers are 32-bit, read-write, reset 0x0 unless marked. A register's access mark holds for its fields unless they carry their own. Offsets are from the block's base; [hi:lo] are bit positions; {n}, {i} and the like mark numbered series; 'fields as' and 'values as' point back to an identical list.

## INPUTMUX0 — INPUTMUX
Base 0x40001000
{0x20+4i} CTIMER0CAP[{i}] (i=0..3) reset 0x7F — Capture select register for CTIMER inputs
  [6:0] INP — Input number for CTIMER0
    {v}=CT_INP{v-1} input is selected (v=1..10); {v}=CT_INP{v-1} input is selected (v=13..20); 21=USB0 usb0 start of frame input is selected; {v}=AOI0_OUT{v-22} input is selected (v=22..25); {v}=ADC0_tcomp[{v-26}] input is selected (v=26..29); 30=CMP0_OUT input is selected selected; 31=CMP1_OUT input is selected selected; 33=CTimer1_MAT1 input is selected; 34=CTimer1_MAT2 input is selected; 35=CTimer1_MAT3 input is selected; 36=CTimer2_MAT1 input is selected; 37=CTimer2_MAT2 input is selected; 38=CTimer2_MAT3 input is selected; 39=QDC0_CMP_FLAG0 input input is selected; 40=QDC0_CMP_FLAG1 input is selected; 41=QDC0_CMP_FLAG2 input is selected; 42=QDC0_CMP_FLAG3 input is selected; 43=QDC0_POS_MATCH0 input is selected; 44=PWM0_SM0_OUT_TRIG0 input is selected; 45=PWM0_SM1_OUT_TRIG0 input is selected; 46=PWM0_SM2_OUT_TRIG0 input is selected; 48=LPI2C0 Master End of Packet input is selected; 49=LPI2C0 Slave End of Packet input is selected; 52=LPSPI0 End of Frame input is selected; 53=LPSPI0 Received Data Word input is selected; 54=LPSPI1 End of Frame input is selected; 55=LPSPI1 Received Data Word input is selected; 56=LPUART0 Received Data Word input is selected; 57=LPUART0 Transmitted Data Word input is selected; 58=LPUART0 Receive Line Idle input is selected; 59=LPUART1 Received Data Word input is selected; 60=LPUART1 Transmitted Data Word input is selected; 61=LPUART1 Receive Line Idle input is selected; 62=LPUART2 Received Data Word input is selected; 63=LPUART2 Transmitted Data Word input is selected; 64=LPUART2 Receive Line Idle input is selected
0x30 TIMER0TRIG reset 0x7F — Trigger register for TIMER0
  [6:0] INP — Input number for CTIMER0
    {v}=CT_INP{v-1} input is selected (v=1..10); {v}=CT_INP{v-1} input is selected (v=13..20); 21=USB0 usb0 start of frame input is selected; {v}=AOI0_OUT{v-22} input is selected (v=22..25); {v}=ADC0_tcomp[{v-26}] input is selected (v=26..29); 30=CMP0_OUT input is selected selected; 31=CMP1_OUT input is selected selected; 33=CTimer1_MAT1 input is selected; 34=CTimer1_MAT2 input is selected; 35=CTimer1_MAT3 input is selected; 36=CTimer2_MAT1 input is selected; 37=CTimer2_MAT2 input is selected; 38=CTimer2_MAT3 input is selected; {v}=QDC0_CMP_FLAG{v-39} input is selected (v=39..42); 43=QDC0_POS_MATCH0 input is selected; 44=PWM0_SM0_OUT_TRIG0 input is selected; 45=PWM0_SM1_OUT_TRIG0 input is selected; 46=PWM0_SM2_OUT_TRIG0 input is selected; 48=LPI2C0 Master End of Packet input is selected; 49=LPI2C0 Slave End of Packet input is selected; 52=LPSPI0 End of Frame input is selected; 53=LPSPI0 Received Data Word input is selected; 54=LPSPI1 End of Frame input is selected; 55=LPSPI1 Received Data Word input is selected; 56=LPUART0 Received Data Word input is selected; 57=LPUART0 Transmitted Data Word input is selected; 58=LPUART0 Receive Line Idle input is selected; 59=LPUART1 Received Data Word input is selected; 60=LPUART1 Transmitted Data Word input is selected; 61=LPUART1 Receive Line Idle input is selected; 62=LPUART2 Received Data Word input is selected; 63=LPUART2 Transmitted Data Word input is selected; 64=LPUART2 Receive Line Idle input is selected
{0x40+4i} CTIMER1CAP[{i}] (i=0..3) reset 0x7F — Capture select register for CTIMER inputs
  [6:0] INP — Input number for CTIMER0
    {v}=CT_INP{v-1} input is selected (v=1..10); {v}=CT_INP{v-1} input is selected (v=13..20); 21=USB0 usb0 start of frame input is selected; {v}=AOI0_OUT{v-22} input is selected (v=22..25); {v}=ADC0_tcomp[{v-26}] input is selected (v=26..29); 30=CMP0_OUT input is selected; 31=CMP1_OUT input is selected; 33=CTimer0_MAT1 input is selected; 34=CTimer0_MAT2 input is selected; 35=CTimer0_MAT3 input is selected; 36=CTimer2_MAT1 input is selected; 37=CTimer2_MAT2 input is selected; 38=CTimer2_MAT3 input is selected; {v}=QDC0_CMP_FLAG{v-39} input is selected (v=39..42); 43=QDC0_POS_MATCH0 input is selected; 44=PWM0_SM0_OUT_TRIG0 input is selected; 45=PWM0_SM1_OUT_TRIG0 input is selected; 46=PWM0_SM2_OUT_TRIG0 input is selected; 48=LPI2C0 Master End of Packet input is selected; 49=LPI2C0 Slave End of Packet input is selected; 52=LPSPI0 End of Frame input is selected; 53=LPSPI0 Received Data Word input is selected; 54=LPSPI1 End of Frame input is selected; 55=LPSPI1 Received Data Word input is selected; 56=LPUART0 Received Data Word input is selected; 57=LPUART0 Transmitted Data Word input is selected; 58=LPUART0 Receive Line Idle input is selected; 59=LPUART1 Received Data Word input is selected; 60=LPUART1 Transmitted Data Word input is selected; 61=LPUART1 Receive Line Idle input is selected; 62=LPUART2 Received Data Word input is selected; 63=LPUART2 Transmitted Data Word input is selected; 64=LPUART2 Receive Line Idle input is selected
0x50 TIMER1TRIG reset 0x7F — Trigger register for TIMER1
  fields as CTIMER1CAP[0]
{0x60+4i} CTIMER2CAP[{i}] (i=0..3) reset 0x7F — Capture select register for CTIMER inputs
  [6:0] INP — Input number for CTIMER0
    {v}=CT_INP{v-1} input is selected (v=1..10); {v}=CT_INP{v-1} input is selected (v=13..20); 21=USB0 usb0 start of frame input is selected; {v}=AOI0_OUT{v-22} input is selected (v=22..25); {v}=ADC0_tcomp[{v-26}] input is selected (v=26..29); 30=CMP0_OUT input is selected; 31=CMP1_OUT input is selected; 33=CTimer0_MAT1 input is selected; 34=CTimer0_MAT2 input is selected; 35=CTimer0_MAT3 input is selected; 36=CTimer1_MAT1 input is selected; 37=CTimer1_MAT2 input is selected; 38=CTimer1_MAT3 input is selected; {v}=QDC0_CMP_FLAG{v-39} input is selected (v=39..42); 43=QDC0_POS_MATCH0 input is selected; 44=PWM0_SM0_OUT_TRIG0 input is selected; 45=PWM0_SM1_OUT_TRIG0 input is selected; 46=PWM0_SM2_OUT_TRIG0 input is selected; 48=LPI2C0 Master End of Packet input is selected; 49=LPI2C0 Slave End of Packet input is selected; 52=LPSPI0 End of Frame input is selected; 53=LPSPI0 Received Data Word input is selected; 54=LPSPI1 End of Frame input is selected; 55=LPSPI1 Received Data Word input is selected; 56=LPUART0 Received Data Word input is selected; 57=LPUART0 Transmitted Data Word input is selected; 58=LPUART0 Receive Line Idle input is selected; 59=LPUART1 Received Data Word input is selected; 60=LPUART1 Transmitted Data Word input is selected; 61=LPUART1 Receive Line Idle input is selected; 62=LPUART2 Received Data Word input is selected; 63=LPUART2 Transmitted Data Word input is selected; 64=LPUART2 Receive Line Idle input is selected
0x70 TIMER2TRIG reset 0x7F — Trigger register for TIMER2 inputs
  [6:0] INP — Input number for CTIMER0
    {v}=CT_INP{v-1} input is selected (v=1..10); {v}=CT_INP{v-1} input is selected (v=13..20); 21=USB0 usb0 start of frame input is selected; {v}=AOI0_OUT{v-22} input is selected (v=22..25); {v}=ADC0_tcomp[{v-26}] input is selected (v=26..29); 30=CMP0_OUT input is selected selected; 31=CMP1_OUT input is selected selected; 33=CTimer0_MAT1 input is selected; 34=CTimer0_MAT2 input is selected; 35=CTimer0_MAT3 input is selected; 36=CTimer1_MAT1 input is selected; 37=CTimer1_MAT2 input is selected; 38=CTimer1_MAT3 input is selected; {v}=QDC0_CMP_FLAG{v-39} input is selected (v=39..42); 43=QDC0_POS_MATCH0 input is selected; 44=PWM0_SM0_OUT_TRIG0 input is selected; 45=PWM0_SM1_OUT_TRIG0 input is selected; 46=PWM0_SM2_OUT_TRIG0 input is selected; 48=LPI2C0 Master End of Packet input is selected; 49=LPI2C0 Slave End of Packet input is selected; 52=LPSPI0 End of Frame input is selected; 53=LPSPI0 Received Data Word input is selected; 54=LPSPI1 End of Frame input is selected; 55=LPSPI1 Received Data Word input is selected; 56=LPUART0 Received Data Word input is selected; 57=LPUART0 Transmitted Data Word input is selected; 58=LPUART0 Receive Line Idle input is selected; 59=LPUART1 Received Data Word input is selected; 60=LPUART1 Transmitted Data Word input is selected; 61=LPUART1 Receive Line Idle input is selected; 62=LPUART2 Received Data Word input is selected; 63=LPUART2 Transmitted Data Word input is selected; 64=LPUART2 Receive Line Idle input is selected
0x180 FREQMEAS_REF reset 0x1F — Selection for frequency measurement reference clock
  [4:0] INP — Clock source number (binary value) for frequency measure function target clock.
    1=clk_in input is selected; 2=FRO_OSC_12M input is selected; 3=fro_hf_div input is selected; 5=clk_16k[1] input is selected; 6=SLOW_CLK input is selected; 7=FREQME_CLK_IN0 input is selected; 8=FREQME_CLK_IN1 input is selected; 9=AOI0_OUT0 input is selected; 10=AOI0_OUT1 input is selected; 11=PWM0_SM0_OUT_TRIG0 input is selected; 12=PWM0_SM0_OUT_TRIG1 input is selected; 13=PWM0_SM1_OUT_TRIG0 input is selected; 14=PWM0_SM1_OUT_TRIG1 input is selected; 15=PWM0_SM2_OUT_TRIG0 input is selected; 16=PWM0_SM2_OUT_TRIG1 input is selected
0x184 FREQMEAS_TAR reset 0x1F — Selection for frequency measurement reference clock
  fields as FREQMEAS_REF
0x260 CMP0_TRIG reset 0x3F — CMP0 input connections
  [5:0] TRIGIN — CMP0 input trigger
    1=ARM_TXEV input is selected; {v}=AOI0_OUT{v-2} input is selected (v=2..5); 6=CMP1_OUT input is selected; 8=CTimer0_MAT0 input is selected; 9=CTimer0_MAT2 input is selected; 10=CTimer1_MAT0 input is selected; 11=CTimer1_MAT2 input is selected; 12=CTimer2_MAT0 input is selected; 13=CTimer2_MAT2 input is selected; 14=LPTMR0 input is selected; 16=QDC0_POS_MATCH0; 17=PWM0_SM0_OUT_TRIG0 input is selected; 18=PWM0_SM0_OUT_TRIG1 input is selected; 19=PWM0_SM1_OUT_TRIG0 input is selected; 20=PWM0_SM1_OUT_TRIG1 input is selected; 21=PWM0_SM2_OUT_TRIG0 input is selected; 22=PWM0_SM2_OUT_TRIG1 input is selected; {v}=GPIO{v-25} Pin Event Trig 0 input is selected (v=25..28); 30=WUU input is selected
{0x280+4i} ADC0_TRIG[{i}] (i=0..3) reset 0x3F — ADC Trigger input connections
  [5:0] TRIGIN — ADC0 trigger inputs
    1=ARM_TXEV input is selected; {v}=AOI0_OUT{v-2} input is selected (v=2..5); 6=CMP0_OUT input is selected; 7=CMP1_OUT input is selected; 9=CTimer0_MAT0 input is selected; 10=CTimer0_MAT1 input is selected; 11=CTimer1_MAT0 input is selected; 12=CTimer1_MAT1 input is selected; 13=CTimer2_MAT0 input is selected; 14=CTimer2_MAT1 input is selected; 15=LPTMR0 input is selected; 17=QDC0_POS_MATCH0 input is selected; 18=PWM0_SM0_OUT_TRIG0 input is selected; 19=PWM0_SM0_OUT_TRIG1 input is selected; 20=PWM0_SM1_OUT_TRIG0 input is selected; 21=PWM0_SM1_OUT_TRIG1 input is selected; 22=PWM0_SM2_OUT_TRIG0 input is selected; 23=PWM0_SM2_OUT_TRIG1 input is selected; {v}=GPIO{v-26} Pin Event Trig 0 input is selected (v=26..29); 31=WUU
0x360 QDC0_TRIG reset 0x3F — QDC0 Trigger Input Connections
  [5:0] INP — QDC0 input connections
    1=ARM_TXEV input is selected; {v}=AOI0_OUT{v-2} input is selected (v=2..5); 6=CMP0_OUT input is selected; 7=CMP1_OUT input is selected; 9=CTimer0_MAT2 input is selected; 10=CTimer0_MAT3 input is selected; 11=CTimer1_MAT2 input is selected; 12=CTimer1_MAT3 input is selected; 13=CTimer2_MAT2 input is selected; 14=CTimer2_MAT3 input is selected; 15=QDC0_POS_MATCH0 input is selected; 16=PWM0_SM0_OUT_TRIG0 input is selected; 17=PWM0_SM0_OUT_TRIG1 input is selected; 18=PWM0_SM1_OUT_TRIG0 input is selected; 19=PWM0_SM1_OUT_TRIG1 input is selected; 20=PWM0_SM2_OUT_TRIG0 input is selected; 21=PWM0_SM2_OUT_TRIG1 input is selected; {v}=TRIG_IN{v-24} input is selected (v=24..35); {v}=GPIO{v-36} Pin Event Trig 0 input is selected (v=36..39)
0x364 QDC0_HOME reset 0x3F — QDC0 Trigger Input Connections
  fields as QDC0_TRIG
0x368 QDC0_INDEX reset 0x3F — QDC0 Trigger Input Connections
  fields as QDC0_TRIG
0x36C QDC0_PHASEB reset 0x3F — QDC0 Trigger Input Connections
  fields as QDC0_TRIG
0x370 QDC0_PHASEA reset 0x3F — QDC0 Trigger Input Connections
  fields as QDC0_TRIG
{0x370+4i} QDC0_ICAP{i} reset 0x3F (i=1..3) — QDC0 Trigger Input Connections
  fields as QDC0_TRIG
{0x3A0+8i} FlexPWM0_SM{i}_EXTA{i} reset 0x3F (i=0..2) — PWM0 input trigger connections
  [5:0] TRIGIN — Trigger input connections for PWM0
    1=ARM_TXEV input is selected; {v}=AOI0_OUT{v-2} input is selected (v=2..5); 6=CMP0_OUT input is selected; 7=CMP1_OUT input is selected; 9=CTimer0_MAT2 input is selected; 10=CTimer0_MAT3 input is selected; 11=CTimer1_MAT2 input is selected; 12=CTimer1_MAT3 input is selected; 13=CTimer2_MAT2 input is selected; 14=CTimer2_MAT3 input is selected; {v}=QDC0_CMP_FLAG{v-15} input is selected (v=15..18); 19=QDC0_POS_MATCH0 input is selected; {v}=TRIG_IN{v-20} input is selected (v=20..31); {v}=GPIO{v-32} Pin Event Trig 0 input is selected (v=32..35)
{0x3A4+8i} FlexPWM0_SM{i}_EXTSYNC{i} reset 0x3F (i=0..2) — PWM0 input trigger connections
  fields as FlexPWM0_SM0_EXTA0
{0x3C0+4i} FlexPWM0_FAULT{i} reset 0x3F (i=0..3) — PWM0 input trigger connections
  fields as FlexPWM0_SM0_EXTA0
0x3D0 FlexPWM0_FORCE reset 0x3F — PWM0 input trigger connections
  fields as FlexPWM0_SM0_EXTA0
0x420 PWM0_EXT_CLK reset 0x7 — PWM0 external clock trigger
  [2:0] TRIGIN — Trigger input connections for PWM
    1=clk_16k[1] input is selected; 2=clk_in input is selected; 3=AOI0_OUT0 input is selected; 4=AOI0_OUT1 input is selected; 5=EXTTRIG_IN0 input is selected; 6=EXTTRIG_IN7 input is selected
{0x440+4i} AOI0_MUX[{i}] (i=0..15) reset 0x3F — AOI0 trigger input connections 0-15
  [5:0] INP — AOI0 trigger input connections
    1=ADC0_tcomp[0] input is selected input is selected input is selected; 2=ADC0_tcomp[1] input is selected input is selected; 3=ADC0_tcomp[2] input is selected input is selected; 4=ADC0_tcomp[3] input is selected input is selected; 5=CMP0_OUT input is selected; 6=CMP1_OUT input is selected; {v}=CTimer0_MAT{v-8} input is selected (v=8..11); {v}=CTimer1_MAT{v-12} input is selected (v=12..15); {v}=CTimer2_MAT{v-16} input is selected (v=16..19); 20=LPTMR0 input is selected; 22=QDC0_CMP_FLAG0 input input is selected; 23=QDC0_CMP_FLAG1 input is selected; 24=QDC0_CMP_FLAG2 input is selected; 25=QDC0_CMP_FLAG3 input is selected; 26=QDC0_POS_MATCH input is selected; 27=PWM0_SM0_OUT_TRIG0 0 input is selected; 28=PWM0_SM0_OUT_TRIG1 input is selected; 29=PWM0_SM1_OUT_TRIG0 input is selected; 30=PWM0_SM1_OUT_TRIG1 input is selected; 31=PWM0_SM2_OUT_TRIG0 input is selected; 32=PWM0_SM2_OUT_TRIG1 input is selected; {v}=TRIG_IN{v-35} input is selected (v=35..46); {v}=GPIO{v-47} Pin Event Trig 0 input is selected (v=47..50)
0x480 USBFS_TRIG reset 0x7 — USB-FS trigger input connections
  [2:0] INP — USB-FS trigger input connections.
    1=LPUART0 lpuart_trg_txdata input is selected; 2=LPUART1 lpuart_trg_txdata input is selected; 3=LPUART2 lpuart_trg_txdata input is selected
{0x4C0+4i} EXT_TRIG[{i}] (i=0..4) reset 0x1F — EXT trigger connections 0-4
  [4:0] INP — EXT trigger input connections
    1=ARM_TXEV input is selected; {v}=AOI0_OUT{v-2} input is selected (v=2..5); 6=CMP0_OUT input is selected; 7=CMP1_OUT input is selected; 9=LPUART0 input is selected; 10=LPUART1 input is selected; 11=LPUART2 input is selected
{0x4C0+4i} EXT_TRIG{i} (i=6..7) reset 0x1F — EXT trigger connections 6-7
  fields as EXT_TRIG[0]
0x4E0 CMP1_TRIG reset 0x3F — CMP1 input connections
  [5:0] TRIGIN — CMP0 input trigger
    1=ARM_TXEV input is selected; {v}=AOI0_OUT{v-2} input is selected (v=2..5); 6=CMP0_OUT input is selected; 8=CTimer0_MAT0 input is selected; 9=CTimer0_MAT2 input is selected; 10=CTimer1_MAT0 input is selected; 11=CTimer1_MAT2 input is selected; 12=CTimer2_MAT0 input is selected; 13=CTimer2_MAT2 input is selected; 14=LPTMR0 input is selected; 16=QDC0_CMP/POS_MATCH0; 17=PWM0_SM0_OUT_TRIG0 input is selected; 18=PWM0_SM0_OUT_TRIG1 input is selected; 19=PWM0_SM1_OUT_TRIG0 input is selected; 20=PWM0_SM1_OUT_TRIG1 input is selected; 21=PWM0_SM2_OUT_TRIG0 input is selected; 22=PWM0_SM2_OUT_TRIG1 input is selected; {v}=GPIO{v-25} Pin Event Trig 0 input is selected (v=25..28); 30=WUU input is selected
0x5A0 LPI2C0_TRIG reset 0x3F — LPI2C0 trigger input connections
  [5:0] INP
    1=ARM_TXEV; {v}=AOI0_OUT{v-2} input is selected (v=2..5); 6=CMP0_OUT input is selected; 7=CMP1_OUT input is selected; 9=CTimer0_MAT0 input is selected; 10=CTimer0_MAT1 input is selected; 11=CTimer1_MAT0 input is selected; 12=CTimer1_MAT1 input is selected; 13=CTimer2_MAT0 input is selected; 14=CTimer2_MAT1 input is selected; 15=LPTMR0 input is selected; {v}=TRIG_IN{v-17} input is selected (v=17..24); {v}=GPIO{v-25} Pin Event Trig 0 input is selected (v=25..28); 42=WUU input is selected
0x5E0 LPSPI0_TRIG reset 0x3F — LPSPI0 trigger input connections
  [5:0] INP
    1=ARM_TXEV; {v}=AOI0_OUT{v-2} input is selected (v=2..5); 6=CMP0_OUT input is selected; 7=CMP1_OUT input is selected; 9=CTimer0_MAT1 input is selected; 10=CTimer0_MAT2 input is selected; 11=CTimer1_MAT1 input is selected; 12=CTimer1_MAT2 input is selected; 13=CTimer2_MAT1 input is selected; 14=CTimer2_MAT2 input is selected; 15=LPTMR0 input is selected; {v}=TRIG_IN{v-17} input is selected (v=17..24); {v}=GPIO{v-25} Pin Event Trig 0 input is selected (v=25..28); 42=WUU input is selected
0x600 LPSPI1_TRIG reset 0x3F — LPSPI1 trigger input connections
  fields as LPSPI0_TRIG
{0x620+0x20*i} LPUART{i} reset 0x3F (i=0..2) — LPUART{i} trigger input connections
  [5:0] INP
    1=ARM_TXEV; {v}=AOI0_OUT{v-2} input is selected (v=2..5); 6=CMP0_OUT input is selected; 7=CMP1_OUT input is selected; 9=CTimer0_MAT2 input is selected; 10=CTimer0_MAT3 input is selected; 11=CTimer1_MAT2 input is selected; 12=CTimer1_MAT3 input is selected; 13=CTimer2_MAT2 input is selected; 14=CTimer2_MAT3 input is selected; 15=LPTMR0 input is selected; {v}=TRIG_IN{v-17} input is selected (v=17..28); {v}=GPIO0 Pin Event Trig 0 input is selected (v=29..32); 34=WUU input is selected; 35=USB0 ipp_ind_uart_rxd_usbmux input is selected

## Notices in the file
Copyright 2016-2024 NXP
SPDX-License-Identifier: BSD-3-Clause
